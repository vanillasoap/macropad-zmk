## config/boards/shields/cu7/Kconfig.defconfig
```kconfig
# Copyright (c) 2020 The ZMK Contributors
# SPDX-License-Identifier: MIT

if SHIELD_cu7

config ZMK_KEYBOARD_NAME
    default "cu7"

endif
```
